## boards/arm/mist_ble/Kconfig.board
```kconfig
# Kconfig - Mist BLE board configuration
#
# Copyright (c) 2019 Mist Systems Inc.
#
# SPDX-License-Identifier: Apache-2.0

config  BOARD_MIST_BLE
	bool "Mist BLE"
	depends on SOC_NRF52832_QFAA
```

## boards/arm/mist_ble/Kconfig.defconfig
```kconfig
# Kconfig - Mist APHX board configuration
#
# Copyright (c) 2019 Mist Systems Inc.
#
# SPDX-License-Identifier: Apache-2.0

if BOARD_MIST_BLE

config BOARD
	default "mist_ble"

endif # BOARD_MIST_APHX
```

## boards/arm/mist_ble/mist_ble_defconfig
```kconfig
# SPDX-License-Identifier: Apache-2.0

#CONFIG_ARM=y
#CONFIG_SOC_FAMILY_NRF=y
CONFIG_SOC_SERIES_NRF52X=y
CONFIG_SOC_NRF52832_QFAA=y
CONFIG_BOARD_MIST_BLE=y

# Enable MPU
CONFIG_ARM_MPU=y

# Enable GPIO
CONFIG_GPIO=y

# Enable uart driver
CONFIG_SERIAL=y

# Enable console
CONFIG_CONSOLE=y
CONFIG_UART_CONSOLE=y

# Enable RTT
CONFIG_USE_SEGGER_RTT=y
CONFIG_RTT_CONSOLE=y

# Additional board options
CONFIG_GPIO_AS_PINRESET=y
```
